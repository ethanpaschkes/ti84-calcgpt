## wireless/esp32s3-loader/sdkconfig.defaults
```kconfig
CONFIG_IDF_TARGET="esp32s3"
CONFIG_ESPTOOLPY_FLASHSIZE_4MB=y
CONFIG_ESP_CONSOLE_UART_DEFAULT=y
CONFIG_FREERTOS_HZ=1000
CONFIG_PARTITION_TABLE_SINGLE_APP_LARGE=y
CONFIG_MBEDTLS_CERTIFICATE_BUNDLE=y
CONFIG_MBEDTLS_CERTIFICATE_BUNDLE_DEFAULT_CMN=y
CONFIG_ESP_CONSOLE_SECONDARY_NONE=y
```

## wireless/esp32s3-u2u/sdkconfig.defaults
```kconfig
CONFIG_IDF_TARGET="esp32s3"
CONFIG_ESPTOOLPY_FLASHSIZE_4MB=y
CONFIG_ESP_CONSOLE_UART_DEFAULT=y
CONFIG_ESP_CONSOLE_SECONDARY_NONE=y
CONFIG_FREERTOS_HZ=1000
CONFIG_PARTITION_TABLE_SINGLE_APP_LARGE=y
CONFIG_TINYUSB_VENDOR_COUNT=1
```
